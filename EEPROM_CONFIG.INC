
#IFNDEF	EEPROM_CONFIG
#define	EEPROM_CONFIG

#IFNDEF	EEPROM_DEF
#include EEPROM_DEF.INC 
#endif

;
;****************************************************************
;****************************************************************
;		EEPROM CONFIGURATION INSTRUCTIONS
;****************************************************************
;****************************************************************
;EEPROM ACCESS
;	IN ORDER TO CHANGE USER CONFIGURATION SETTINGS, 
;	THE CONFIGURATION FOR THE BigZ IS STORED IN EEPROM MEMORY. 
;	ACCESS TO THE MEMORY IS INITIATED BY:
;		1) PULL PIN 6 OF J1 LOW AT POWER-UP
;		2) SEND ASCII CHARACTERS 'UUU_BZ_CONFIG' TO THE SERIAL PORT. 
;		3) SEND /CR/LF
;		4) A '$' character will be returned, indicating the PIC is ready to receive commands
;	
;	COMMANDS AVAILABLE:
;		1) 'R' (READ)
;			SYNTAX: "R [REG_NUM]"
;			RESPONSE: THE BigZ WILL REPORT THE VALUE AT REG_NUM. IF NO REG_NUM IS ENTERED, THE 
;					  BigZ WILL REPORT ALL OF THEM
;		2) 'W'	(WRITE)
;			SYNTAX: "W REG_NUM1, REG_VAL1"
;			RESPONSE: THE BigZ WILL WRITE REG_VAL TO REG_NUM, THEN READ AND REPORT THE 
;					  REG_VAL AT REG_NUM.
;		3) '(ESC KEY)' QUIT. Causes a reset to the BigZ's PIC.
;	
;		4) '?'	PRINTS BRIEF HELP MESSAGE
;
;		5) 'F'	(FACTORY RESET)
;
;		ALL OTHER ENTRIES ARE ILLEGAL. IF ANY ILLEGAL CHARACTERS ARE ENTERED, THE CURSOR RESETS
;
;****************************************************************
;****************************************************************
;	EEPROM REGISTER MAPPING:
;****************************************************************

;------------------------------------------------------------------------------
; EEPROM INITIALIZATION
; The 16F1933 has 256 bytes of non-volatile EEPROM, starting at address 0xF000
;------------------------------------------------------------------------------
; Example: DE    "MCHP"  ; Place 'M' 'C' 'H' 'P' at address 0,1,2,3
; USER SETTINGS TABLE. INITIALLY, THESE SETTINGS MATCH THE FACTORY DEFAULTS, BUT ARE CONFIGURABLE
;**************************************************************************
; TASK: INITIALIZE_EEPROM_VALUES
; THE FOLLOWING LINE INITIALIZE THE EEPROM. DURING PROGRAMMING. 
; THIS IS THE 'FACTORY DEFAULT' SO TO SPEAK
;**************************************************************************
; AFTER PROGRAMMING, THE EEPROM CONTENTS SHOULD LOOK LIKE THIS:
; Address  00 01 02 03 04 05 06 07 08 09 0A 0B 0C 0D 0E 0F      ASCII      
;
;    00    0F 3F 3F 03 75 28 26 20 20 20 20 20 20 3F 07 75 	.??.u(&       ?.u
;    10    96 96 96 96 96 71 72 73 74 75 71 71 71 71 FF FF 	.....qrs tuqqqq..
;    20    96 FF FF FF FF FF FF FF FF FF 96 71 FF FF FF FF 	........ ...q....
;    30    19 00 00 00 00 FF FF FF FF FF 96 71 FF FF FF FF 	........ ...q....
;    40    96 FF FF FF FF FF FF FF FF FF 96 71 FF FF FF FF 	........ ...q....
;    50    96 FF FF FF FF FF FF FF FF FF FF FF FF FF FF FF 	........ ........
;    60    FF FF FF FF FF FF FF FF FF FF FF FF FF FF FF FF 	........ ........
;    70    FF FF FF FF FF FF FF FF FF FF FF FF FF FF FF FF 	........ ........
;    80    0F 3F 3F 03 75 28 26 20 20 20 20 20 20 3F 07 75 	.??.u(&       ?.u
;    90    96 96 96 96 96 71 72 73 74 75 71 71 71 71 FF FF 	.....qrs tuqqqq..
;    A0    96 FF FF FF FF FF FF FF FF FF 96 71 FF FF FF FF 	........ ...q....
;    B0    19 00 00 00 00 FF FF FF FF FF 96 71 FF FF FF FF 	........ ...q....
;    C0    62 69 67 5A 20 46 57 20 56 45 52 53 49 4F 4E 3A 	bigZ FW  VERSION:
;    D0    30 2E 31 37 FF FF FF FF FF FF FF FF FF FF FF FF 	0.17.... ........
;    E0    FF FF FF FF FF FF FF FF FF FF FF FF FF FF FF FF 	........ ........
;    F0    FF FF FF FF FF FF FF FF FF FF FF FF FF FF FF 02 	........ ........
;
;**************************************************************************


; PROGRAM 0X00 - 0X06...EE_CONFIG,EE_EN_AA,EE_EN_RXADDR,EE_SETUP_AW,EE_SETUP_RETR,EE_RF_CH,EE_RF_SETUP
ORG  EEPROM_START_ADD + 0X00				;0xF000 FOR '1933
de	CONFIG_VAL,EN_AA_VAL,EN_RXADDR_VAL,SETUP_AW_VAL,SETUP_RETR_VAL,RF_CH_VAL,RF_SETUP_VAL	; load eeprom locations 0 through 7

; PROGRAM 0X07 - 0X0C...EE_LOC_RX_PW_P0	EE_LOC_PW_P1, EE_LOC_PW_P2, EE_LOC_PW_P3, EE_LOC_PW_P4, EE_LOC_PW_P5
ORG  EEPROM_START_ADD + 0X07
DE RX_PW_Px_VAL, RX_PW_Px_VAL, RX_PW_Px_VAL, RX_PW_Px_VAL, RX_PW_Px_VAL, RX_PW_Px_VAL ; PAYLOAD WIDTHS, THESE ARE PLACEHOLDERS RIGHT NOW
																				  ; SINCE DYNAMIC PAYOAD IS USED
; PROGRAM 0X0D, 0X0E...EE_DYNPD, EE_FEATURE
ORG  EEPROM_START_ADD + 0X0D	;
de	DYNPD_VAL, FEATURE_VAL

; PROGRAM 0X10 - 0X14	EE_TX_ADD_0,EE_TX_ADD_1,EE_TX_ADD_2,EE_TX_ADD_3,EE_TX_ADD_4
; BOTH TX AND RX0 PIPELINE SHARE THE SAME ADDRESS.
org	EEPROM_START_ADD + 0x10
de	TXAD0_VAL,TXAD1_VAL,TXAD2_VAL,TXAD3_VAL,TXAD4_VAL

; PROGRAM 0X15 - 0X1D...EE_RXP1_ADD_0,EE_RXP2_ADD_0,EE_RXP3_ADD_0,EE_RXP4_ADD_0,EE_RXP5_ADD_0,
;	AND COMMON ADDRESS BYTES AT EE_RXPx_ADD_1,EE_RXPx_ADD_2,EE_RXPx_ADD_3,EE_RXPx_ADD_4
org	EEPROM_START_ADD + 0x15
de	RXAD1_0_VAL,RXAD2_0_VAL,RXAD3_0_VAL,RXAD4_0_VAL,RXAD5_0_VAL,RXAD1_1_VAL,RXAD1_2_VAL,RXAD1_3_VAL,RXAD1_4_VAL,

; PROGRAM  0X20 - 0X2F RESERVED FOR FUTURE NRF SETTING...

; PROGRAM  0X30 - 0X3F FOR PIC CONFIGURABLE SETTING...
org	EEPROM_START_ADD + 0x30
DE	SPBRGL_VAL, SPBRGH_VAL, OP_MODE_0_VAL, FHOP_MODE_FAC_DEF, META_DATA_MODE_2_VAL, MISC_FLAGS_VAL

; PROGRAM  0X40 - 0X3F FOR PIC CONFIGURABLE SETTING...
org	EEPROM_START_ADD + 0x40
DE	APP_OPERATION_VAL, DRAGSTER_FLAGS_VAL,	LCR_FLAGS_VAL, BIGZ_FLAGS_VAL

;*******************************************************
;*******************************************************
;	AND KEEP A COPY FOR A FACTORY DEFAULTS FUNCTION
;*******************************************************
;*******************************************************
; PROGRAM 0X00 - 0X06...EE_CONFIG,EE_EN_AA,EE_EN_RXADDR,EE_SETUP_AW,EE_SETUP_RETR,EE_RF_CH,EE_RF_SETUP
ORG  EEPROM_START_ADD + 0X80				;0xF000 FOR '1933
de	CONFIG_VAL,EN_AA_VAL,EN_RXADDR_VAL,SETUP_AW_VAL,SETUP_RETR_VAL,RF_CH_VAL,RF_SETUP_VAL	; load eeprom locations 0 through 7

; PROGRAM 0X07 - 0X0C...EE_LOC_RX_PW_P0	EE_LOC_PW_P1, EE_LOC_PW_P2, EE_LOC_PW_P3, EE_LOC_PW_P4, EE_LOC_PW_P5
ORG  EEPROM_START_ADD + 0X87
DE RX_PW_Px_VAL, RX_PW_Px_VAL, RX_PW_Px_VAL, RX_PW_Px_VAL, RX_PW_Px_VAL, RX_PW_Px_VAL ; PAYLOAD WIDTHS, THESE ARE PLACEHOLDERS RIGHT NOW
																				  ; SINCE DYNAMIC PAYOAD IS USED
; PROGRAM 0X0D, 0X0E...EE_DYNPD, EE_FEATURE
ORG  EEPROM_START_ADD + 0X8D
de	DYNPD_VAL, FEATURE_VAL		

; PROGRAM 0X10 - 0X14	EE_TX_ADD_0,EE_TX_ADD_1,EE_TX_ADD_2,EE_TX_ADD_3,EE_TX_ADD_4
; BOTH TX AND RX0 PIPELINE SHARE THE SAME ADDRESS.
org	EEPROM_START_ADD + 0x90
de	TXAD0_VAL,TXAD1_VAL,TXAD2_VAL,TXAD3_VAL,TXAD4_VAL

; PROGRAM 0X15 - 0X1D...EE_RXP1_ADD_0,EE_RXP2_ADD_0,EE_RXP3_ADD_0,EE_RXP4_ADD_0,EE_RXP5_ADD_0,
;	AND COMMON ADDRESS BYTES AT EE_RXPx_ADD_1,EE_RXPx_ADD_2,EE_RXPx_ADD_3,EE_RXPx_ADD_4
org	EEPROM_START_ADD + 0x95
de	RXAD1_0_VAL,RXAD2_0_VAL,RXAD3_0_VAL,RXAD4_0_VAL,RXAD5_0_VAL,RXAD1_1_VAL,RXAD1_2_VAL,RXAD1_3_VAL,RXAD1_4_VAL

; PROGRAM  0X30 - 0X3F FOR PIC CONFIGURABLE SETTING...
org	EEPROM_START_ADD + 0xB0
DE	SPBRGL_VAL, SPBRGH_VAL, OP_MODE_0_VAL, FHOP_MODE_FAC_DEF, META_DATA_MODE_2_VAL, MISC_FLAGS_VAL

; FOR KEEPING TRACK OF THINGS...
ORG	EEPROM_START_ADD + EE_FW_VERSION_LOC - 0X10
DE  "bigZ FW VERSION:"
ORG EEPROM_START_ADD + EE_FW_VERSION_LOC
DE  "0.17" 

org	EEPROM_START_ADD + 0xFF	;LAST EEPROM ADDRESS....
de	EEPROM_STATUS_VAL



__EEPROM_ROUTINES	CODE
;****************************************************************
;	NAME: EEPROM_READ_W
;	FUNCTION: READS THE DATA AT THE ADDRESS POINTED TO BY WREG
; 	ARGUMENT: W_REG (READS DATA AT THIS ADDRESS)
;	RETURNS:  EEPROM DATA IN THE WREG
; 	AFFECTS:  W_REG, BANKSEL 0
;****************************************************************
EEPROM_READ_W
		BANKSEL 	EEADRL ;
		MOVWF 		EEADRL ;Data Memory Address to read
;****************************************************************
;	NAME: EEPROM_READ
;	FUNCTION: READS THE DATA AT EEADR
; 	ARGUMENT: NONE
;	RETURNS:  EEPROM DATA IN THE WREG
; 	AFFECTS:  W_REG, BANKSEL 0
;****************************************************************
EEPROM_READ
		MOVLW		0XF0
		MOVWF		EEADRH
		BANKSEL 	EECON1 ;
		BCF 		EECON1, CFGS ;Point to DATA memory
		BCF 		EECON1, EEPGD ;Point to DATA memory
		BSF 		EECON1, RD ;EE Read
		BANKSEL		EEDATL
		MOVF 		EEDATL, W ;W = EEDATA
		BANKSEL		0 ;Bank 0
	RETURN	
	
;****************************************************************
;	NAME: EEPROM_WRITE
;	FUNCTION: WRITES THE DATA IN DATA_EE_DATA TO THE ADDRESS POINTED TO BY DATA_EE_ADDR
; 	ARGUMENT: NONE
;	REQUIRES: EEADRL AND EEDATL MUST BE PRE-LOADED BY m_EEPROM_WRITE MACRO
;	RETURNS:  VOID
; 	AFFECTS: DATA IN DATA_EE_ADDR, SETS BANK TO 0
;****************************************************************
EEPROM_WRITE		
    BCF EECON1, CFGS ;Deselect Configuration space
    BCF EECON1, EEPGD ;Point to DATA memory
    BSF EECON1, WREN ;Enable writes
    BCF INTCON, GIE ;Disable INTs.
    MOVLW 55h ;
    MOVWF EECON2 ;Write 55h
    MOVLW 0AAh ;
    MOVWF EECON2 ;Write AAh
    BSF EECON1, WR ;Set WR bit to begin write
    BSF INTCON, GIE ;Enable Interrupts
    BCF EECON1, WREN ;Disable writes
    BTFSC EECON1, WR ;Wait for write to complete
    GOTO $-2 ;Done
  RETURN
;	
;ORG	0X640
USER_CONFIG_CODE	CODE ;0xA40
;--------------------------------------------------------------
;**************************************************************
;**************************************************************
;	Overview: The user config code provides a user interface, from which the user, via a GUI,
;				can adjust the paramaters 

CONFIG_ISR_HANDLER
	BANKSEL	CONFIG_STATUS_REG
	BTFSS	CONFIG_STATUS_REG,	UART_RCIF_ASSERTED
	GOTO	NOT_RCIF_INT
	FARCALL	RCV_INT_ASSERTED
	RETURN

	
RCV_INT_ASSERTED
	; THERE IS A NEW CHARACTER IN THE RECIEVE BUFFER RCREG.
	BANKSEL	CONFIG_STATUS_REG						
	BCF		CONFIG_STATUS_REG,	UART_RCIF_ASSERTED	; CLEAR THE LOCAL INTERRUPT BIT
	BTFSC	CONFIG_STATUS_REG,	PIC_IN_CONFIG_MODE	; ARE WE IN CONFIG MODE?
	GOTO	IN_CONF_MODE							; YES. GO THERE
	BTFSC	CONFIG_STATUS_REG,	PIC_IN_NORMAL_MODE	; NO. ARE WE IN NORMAL MODE?
	RETURN											; YES. LEAVE.
TEST_CONFIG_KEY_CHAR								; NO. WERE STILL TEST FOR THE PROPER KEY.
	MOVLW	HIGH CONFIG_KEY							; GET THE NEXT KEY CHAR				
	MOVWF	BL_REG_PCLATH							; ...PAGE THE TABLE IS ON...
	MOVLW	CONFIG_KEY								; ...ADDRESS OF THE TABLE
	BANKSEL	TBL_START_PTR							; ...
	MOVWF	TBL_START_PTR							; ...
	BANKSEL	CFGKEY_CHR_CNT							; ...LOCATION OF THE NEXT CHAR...
	MOVFW	CFGKEY_CHR_CNT							; ...
	FARCALL	GET_BYTE_W_FROM_TABLE					; ... GO GET IT
	; SEE IF THEY MATCH	
	BANKSEL	RCREG
	XORWF	RCREG,	W								;...DO THEY MATCH?
	BTFSC	STATUS,	Z								;... 
	GOTO	CONFIGISH_STATE							; YES, DO UPDATING
	BANKSEL	CONFIG_STATUS_REG
	BSF		CONFIG_STATUS_REG, PIC_IN_NORMAL_MODE	; NO. PUT PIC IN NORMAL OPERATING MODE
	RETLW	0
CONFIGISH_STATE
	BANKSEL	CFGKEY_CHR_CNT							; ADJUST FOR THE NEXT KEY CHARACTER TEST
	INCF	CFGKEY_CHR_CNT							;...
	MOVFW	CFGKEY_CHR_CNT							;...
	SUBLW	CONFIG_KEY_LENGTH						;...
	BTFSC	STATUS,	C								;...WAS THAT THE LAST CHAR? (HAS STRING BEEN FULLY ENTERED?)
	RETLW	1										;...NOT YET, STILL WAITNG													
ENTER_CONFIG_MODE									;...YES. 
	BANKSEL	CONFIG_STATUS_REG
	BSF		CONFIG_STATUS_REG, PIC_IN_CONFIG_MODE	; COMPLETE CONFIG key received.
	GOTO	USER_CONFIGURATION
	RETURN
;****************************************************************************************		
;****************************************************************************************		


;**************************************************************
;**************************************************************
;	FUNCTION: USER_CONFIGURATION
;	DESCRIPTION: USED TO CHANGE THE OPERATING PARAMATERS OF THE 
;				 RF COMMUNICATION LINK BETWEEN TWO BigZ's. 
;	
;**************************************************************
;**************************************************************

USER_CONFIGURATION
	BSF			CONFIG_COMMAND_REG,	COMMAND_STATE_IDLE
	FARCALL		SETUP_SFRS_FOR_CONFIG_MODE	
	

;	MOVWF		MSG_STRING_POINTER		; STORE IT
;	PAGESEL		CONFIG_INTRO			; ADJUST PCLATH...
;	MOVWF		BL_REG_PCLATH			; THE PAGESELW LEAVES THE PAGESEL VAL IN W
;
;	MOVLW	HIGH	CONFIG_INTRO		; STRING POINTER
;	MOVWF	BL_REG_PCLATH				; ADJUST PCLATH...
;	MOVLW	CONFIG_INTRO
;	MOVWF	TBL_START_PTR
;	FARCALL	IMMEDIATE_PRINTF
;

	m_IMMEDIATE_PRINTF	CONFIG_INTRO			; PRINT THE STRING TO SCREEN.
	CLRF	BKLS_REG3
	;BSF		INTCON,	GIE				;	
	;BSF		INTCON,	PEIE			;	
USER_CONFIG_LOOP

	GOTO	USER_CONFIG_LOOP


;****************************************************************************************		
;   INTERRUPT MIGHT HAVE BEEN THE TIMER. CHECK.
NOT_RCIF_INT
	BANKSEL	CONFIG_STATUS_REG						; FIRST MAKE SURE WE'RE IN CONFIG MODE 
	BTFSS	CONFIG_STATUS_REG, PIC_IN_CONFIG_MODE	
	RETURN
	BTFSS	PIR1, TMR1IF
	GOTO	TMR1IF_NOT_ASSERTED
	BCF		PIR1, TMR1IF
TMR1IF_NOT_ASSERTED
	RETURN	
	
IN_CONF_MODE	
	banksel	RCREG
	movfw	RCREG
	FARCALL	SEND_CHAR_TO_SERIAL_PORT
	BTFSS	CONFIG_COMMAND_REG,	COMMAND_STATE_IDLE
	GOTO	NOT_IDLE_STATE

;--------IDLE-TO-COMMAND-INCOMING------------------------------------------------------------------------	
IDLE_STATE
	BCF		CONFIG_COMMAND_REG,	COMMAND_STATE_IDLE	; NO LONGER IDLE

	XORLW	"R"
	SKIP_NOT_ZERO
	GOTO	READ_COMMAND_COMING
	XORLW	"R"
	
	XORLW	"W"
	SKIP_NOT_ZERO
	GOTO	WRITE_COMMAND_COMING
	XORLW	"W"
	
	XORLW	"F"
	SKIP_NOT_ZERO
	GOTO	FAC_RESET_COMMAND
	XORLW	"F"
	
	XORLW	"?"
	SKIP_NOT_ZERO
	GOTO	HELP_COMMAND
	XORLW	"?"
	
	XORLW	0X1B	; esc key
	SKIP_NOT_ZERO
	GOTO	QUIT_COMMAND
	XORLW	0X1B
		
	GOTO	ARGUMENTS_AND_INVALID_COMMANDS
;--------------------------------------------------------------------------------	

READ_COMMAND_COMING
	BSF	CONFIG_COMMAND_REG,	RD_EEPROM_COMMAND_INCOMING
	RETURN
	
WRITE_COMMAND_COMING
	BSF	CONFIG_COMMAND_REG,	WT_EEPROM_COMMAND_INCOMING
	RETURN
;--------------------------------------------------------------------------------	
FAC_RESET_COMMAND
	MOVLW	0xF0
	BANKSEL	EEADRH
	MOVWF	EEADRH
	MOVLW	FACTORY_RESET_TABLE_START	;
	BANKSEL	EEADRL			;	SET THE EEPROM ADDRESS
	MOVWF	EEADRL
	MOVWF	BK_INDEX_REG					; INDEX REGISTER
	BANKSEL	EEADRL
FAC_RESET_LOOP
	BSF		EEADRL,	0X07				;ADD 0X80..
	FARCALL	EEPROM_READ					;	READ FACTORY RESET EEPROM CONTENTS
	BANKSEL	EEADRL
	BCF		EEADRL,	0X07				;SUBTRACT 0X80..OFFSET BETWEEN FACTORY DEFAULTS AND POWER-UP VALUES
	FARCALL	EEPROM_WRITE				;	WRITE EEPROM
	INCF	EEADRL
	DECFSZ	BK_INDEX_REG
	GOTO	FAC_RESET_LOOP
 	RESET	
;--------------------------------------------------------------------------------	


HELP_COMMAND
	m_IMMEDIATE_PRINTF HELP_RESPONSE
ARGUMENTS_AND_INVALID_COMMANDS	
QUIT_COMMAND
;	MOVLP	0X00
;	GOTO	0X00
	RESET
	
;-------------NOT_IDLE_STATE-------------------------------------------------------------------	
NOT_IDLE_STATE

	BTFSC	CONFIG_COMMAND_REG,	RD_EEPROM_COMMAND_INCOMING
	GOTO	ee_RD_COMMAND_EXECUTE

	BTFSC	CONFIG_COMMAND_REG,	WT_EEPROM_COMMAND_INCOMING
	GOTO	ee_WT_COMMAND_IN_PROCESS


NOT_RCIF
 RETURN
	
	
	
ee_RD_COMMAND_EXECUTE
	MOVWF	CONFIG_ARG_1
	BANKSEL	EEADRL
	MOVWF	EEADRL
	MOVLW	0XF0
	MOVWF	EEADRH
	FARCALL	EEPROM_READ
	FARCALL	SEND_CHAR_TO_SERIAL_PORT
	movlw	0x0A
	FARCALL	SAFE_UART_PUT_CHAR
	MOVLW	0X0D				; CARRIAGE RETURN
	FARCALL	SAFE_UART_PUT_CHAR

	CLRF	CONFIG_COMMAND_REG
	BSF		CONFIG_COMMAND_REG,	COMMAND_STATE_IDLE
 RETURN
	
;********************************************************
;	FUNCTION: ee_WT_COMMAND_IN_PROCESS
;	DESC:	UPON ENTRY, STORES WREG IN CONFIG_ARG_2 
;			THEN TESTS IF ARG1(ADDRESS) HAS BEEN RECIEVED. 
;			IF IT HASN'T, THEN IT STORES WREG IN CONFIG_ARG_1,
;			AND SETS THE ARG1_RECEIVED BIT.
;			UPON THE SUBSEQUENT ENTRY, STORES WREG(DATA) IN ARG_2,
;			CALLS THE EEPROM WRITE ROUTINE, AND UPON RETURN 
;			CLEARS THE COMMAND_ARG1_RECEIVED BIT. RETURNS
;			IF THE EEPROM WRITE WAS SUCCESSFUL.
;********************************************************
ee_WT_COMMAND_IN_PROCESS
	MOVWF	CONFIG_ARG_2					; This cold be arg2, which is the last arg, received
	BTFSC	CONFIG_COMMAND_REG,	COMMAND_ARG1_RECEIVED	; but has arg1 been rec'd?
	GOTO	ee_WT_COMMAND_EXECUTE			; Yes. So wreg IS arg2. We can execute a write.
	MOVWF	CONFIG_ARG_1					; NO! It must be arg1. arg2 will come next interrupt.
	BSF		CONFIG_COMMAND_REG,	COMMAND_ARG1_RECEIVED ; set the flag for next time.
 	RETURN
ee_WT_COMMAND_EXECUTE
	BANKSEL	EEDATL					; VALUE TO WRITE
	MOVWF	EEDATL					;....
	MOVLW	0XF0					
	BANKSEL	EEADRH					; HIGH ADRESS FOR EEPROM IS 0XF0
	MOVWF	EEADRH					;...LOAD IT
	MOVFW	CONFIG_ARG_1			; CONFIG_ARG_1 HAS THE LOW ADDRESS
	BANKSEL	EEADRL					; LOW ADDRESS IS THE SPECIFIC ROM LOCATION
	MOVWF	EEADRL					;...LOAD IT
	FARCALL	EEPROM_WRITE			; DO IT.
; NOW VERIFY WRITE SUCCESS
	FARCALL	EEPROM_READ				; READ LOCATION, WHICH PUTS VALUE IN WREG
	FARCALL	SEND_CHAR_TO_SERIAL_PORT
	movlw	0x0A
	FARCALL	SAFE_UART_PUT_CHAR
	MOVLW	0X0D				; CARRIAGE RETURN
	FARCALL	SAFE_UART_PUT_CHAR

;	XORWF	CONFIG_ARG_2,	W		; COMPARE TO INTENDED VALUE. IF WRITE WAS SUCCESSFUL W WILL EQUAL 0
;	HOUSEKEEPING...
	BCF		CONFIG_COMMAND_REG,	WT_EEPROM_COMMAND_INCOMING
	BCF		CONFIG_COMMAND_REG,	COMMAND_ARG1_RECEIVED
	BSF		CONFIG_COMMAND_REG,	COMMAND_STATE_IDLE
 RETURN
 
 	
	
	

	;#DEFINE CONFIG_STATUS_REG
;--------------------------------------------------------------
;	CONFIG_COMMAND_REG BITS

	RD_EEPROM_COMMAND_INCOMING					EQU	0
	WT_EEPROM_COMMAND_INCOMING					EQU	1
	COMMAND_RECEIVED_EXIT_CONFIG				EQU	2
	COMMAND_RECEIVED_FACTORY_RESET				EQU	3
	COMMAND_RECEIVED_HELP						EQU	4
	COMMAND_ARG1_RECEIVED						EQU	5
	COMMAND_ARG2_RECEIVED						EQU	6
	COMMAND_STATE_IDLE							EQU	7
	

;	CONFIG_STATUS_REG BITS
	STAT_RESERVED_BIT_MASK						EQU	B'00000011'
	UART_RCIF_ASSERTED							EQU	1
	PIC_IN_CONFIG_MODE							EQU	2
	STAT_READY									EQU	3
	STAT_EEPROM_WT_FAIL							EQU	4
	STAT_EEPROM_RD_FAIL							EQU	5
	PIC_IN_NORMAL_MODE							EQU	6
	STAT_LAST_CURSUR_CHAR_UNDERSCORE			EQU	7
	LAST_CURSUR_CHAR_UNDERSCORE_MASK			EQU	B'10000000'
		
;	
	
	
;************SUBROUTINES******************************************

SETUP_SFRS_FOR_CONFIG_MODE
	BANKSEL	INTCON
	BCF		INTCON,	GIE		; OFF FOR NOW...
;	BCF		INTCON,	RB0		;	DONT NEED IT
	BANKSEL	PIR1			;	
	CLRF	PIR1			; CLEAR ALL FLAGS FROM PIR1
	
	BANKSEL	PIE1
	CLRF	PIE1			; DISABLE ALL INTERRUPTS
	BSF		PIE1,	TMR2IE	; ENABLE TMR1 INTERRUPTS
	BSF		PIE1,	RCIE	; ENABLE INTERRUPT FROM SERIAL PORT(TBD)
	 
 RETURN
	

SETUP_CURSOR_TIMER
	BANKSEL	T2CON
	MOVLW		b'01111000'	; FOR TOUTPS<3:0> (BITS 3-6) OF T2CON
	IORWF	T2CON			;'1111' A POST-SCALER OF 1:16
	; SET PRESCALE. 00=1:1, 01=1:2,10=1:4,11=1:8
	BSF	T2CON,	T2CKPS1		; T2CKPS<1>....WHEN SET, PRESCALE CLOCK IS 1:16 OR 1:64\
	BSF	T2CON,	T2CKPS0		; T2CKPS<0>....WHEN SET, PRESCALE CLOCK IS 1:4 OR 1:64 >\ b'11 = 1:64
	BSF	T2CON,	TMR2ON		; START THE C;OCK
 RETURN
 
#endif