;**********************************************************************
;   THIS FILE CONTAINS THE MACROS THAT ARE USED IN THIS PROJECT       *
;**********************************************************************
;                                                                     *
;    FILENAME:	    MACROS.INC                                        *
;    DATE:                                                            *
;    FILE VERSION: F16                                                *
;                                                                     *
;    AUTHOR: LYLE LARSON                                              *
;    NOTES:                                                           *
;                                                                     *
;**********************************************************************

#IFNDEF	MACROS
#DEFINE	MACROS

#INCLUDE EEPROM_DEF.INC

;NOLIST
LIST X=ON

;COMPARE A REGISTER TO A LITERAL. IF EQUAL, CONTINUE. IF NOT EQUAL, BRANCH TO ELSE_BRANCH
m_If_FeqL	MACRO	COMPARE_REG, COMPARE_LIT, ELSE_BRANCH
	movlw	COMPARE_LIT
	XORWF	COMPARE_REG,	W
	BTFSS	STATUS,	Z
	GOTO		ELSE_BRANCH
	endm

SKIP_IF_YES	MACRO
	IORLW	0
	BTFSC	STATUS,	Z
	endm

SKIP_IF_ZERO	macro
	BTFSS	STATUS,	Z
	endm

SKIP_NOT_ZERO	macro
	BTFSC	STATUS,	Z
	endm

SKIP_IF_NOT	MACRO
	IORLW	0
	BTFSS	STATUS,	Z
	ENDM
	
;REGISTER_TO_SCREEN	MACRO	REGNAME_STR_PTR, REG_ADD
;	MOVLW	REGNAME_STR_PTR		;STARTING ADDRESS OF THE NRF REGISTER'S NAME
;	FARCALL	PRINT_B00_STRING	;
;	MOVFW	REG_ADD				;
;	FARCALL	HEXTOUART			; PRINTF WREG
;	ENDM
;
;****************************************************************
;	CSN_HI: SETS THE NRF'S CSN PIN HI. PERFORM AT THE END OF AN SPI
;	COMMAND/DATA TRANSFER INTERCHANGE.
;	CAUSES TRANSMISSION TO START AT THE END OF AN UPLOAD TO THE TX FIFO
CSN_HI	MACRO				
		BANKSEL	PORTC
		BSF		PORTC, 2	
	ENDM

;****************************************************************
;	CSN_LO: SETS THE NRF'S CSN PIN LO. THIS IS NEEDED PRIOR TO ANY SPI TRANSFER
CSN_LO	MACRO	
		BANKSEL	PORTC
		BCF	  	PORTC, 2	
	ENDM

;****************************************************************
; SET_CE_RF24: ALLOWS NRF TO ENTER RX OT TX MODE
CE_HI	MACRO
		BANKSEL	PORTC
		BSF		PORTC, 1	; ACTIVATE TX/RX
	ENDM

;****************************************************************
; CLR_CE_RF24: PUTS NRF INTO STANDBY-I MODE
CE_LO	MACRO
		BANKSEL	PORTC
		BCF		PORTC, 1	; DE-ACTIVATE TX/RX
	ENDM

LIST
;****************************************************************
; m_WTW_NRF_REG	MACRO: WRITE THE CONTENTES OF WREG INTO 
;						  THE NRF REGISTER DESIGNATED BY NRF_REG.
;****************************************************************
m_WTW_NRF_REG		MACRO	VAR_NRF_REG
		CSN_LO
		BANKSEL		REGVAL			
		MOVWF		REGVAL			; TEMPORARILY STORE W HERE
		MOVLW		VAR_NRF_REG	+ WRITE_REG	; DESIGNATE REGISTER ADDRESS (THE AAAAA)
		FARCALL		SPI_TRANSFER		; SEND THE WRITE TO NRF_REG COMMAND
		BANKSEL		REGVAL			; AND THEN SEND THE VALUE
		MOVFW		REGVAL			; ...
		FARCALL		SPI_TRANSFER
		CSN_HI
	ENDM
;****************************************************************
; RD_NRF_REG	FUNCTION: READ THE CONTENTES OF THE NRF REGISTER 
;  						  DESIGNATED BY CONTENTS OF RF_REG. 
;				AFFECT: CONTENTS OF THE REGISTER END UP IN SSPBUF.
;						  
;****************************************************************
;NRF_READ_REG
m_RD_NRF_REG  MACRO 	RD_NRF_REG_CMD_ADD,	NRF_STORE_REG	;RD_NRF_REG_CMD_ADD,	NRF_STORE_REG
			MOVLW		RD_NRF_REG_CMD_ADD					;RD_NRF_REG_CMD_ADD
			BANKSEL		RF24_COMMAND						;RF24_COMMAND
			MOVWF		RF24_COMMAND						;RF24_COMMAND

			MOVLW		NRF_STORE_REG			;NRF_STORE_REG
			MOVWF		NRF_STORE_REG_ADD		;NRF_STORE_REG_ADD
			FARCALL 	SUB_NRF_READ_REG		;SUB_NRF_READ_REG
			BANKSEL		NRF_STORE_REG			;NRF_STORE_REG
	ENDM		

m_NRF_READ_MULTIBYTE_REG	MACRO	REG,  BUF_PTR, LEN
   	CSN_LO						;CSN_LO();	
   	BANKSEL		REG
    MOVLW		REG				; GET THE REGISTER READ COMMAND,
	FARCALL		SPI_TRANSFER		; SEND THE COMMAND
	MOVLW		LEN				; SET UP THE LOOP
	BANKSEL		COUNT_REG		
	MOVWF		COUNT_REG		;/
;WHILE_LEN
	MOVLW		BUF_PTR			; ADDRESS OF BUFFER
	ADDWF		COUNT_REG,	W	; OFFSET
	ADDLW		0XFF			; TO SUBTRACT ONE, ACTUALLY
	MOVWF		FSR1L			; AND PUT IT IN THE FSR
	MOVLW		0XFF			; JUST FOR CLOCKING...
	FARCALL		SPI_TRANSFER		; GET A BYTE
;	CLRF		FSR1H			;
	MOVWF		INDF1			; 
	DECFSZ		COUNT_REG		; AND REPEAT LEN-1 TIMES
	GOTO		$-.11				;WHILE_LEN		;//
   	CSN_HI						;DONE. UN-ASSERT CSN_HI();	
	ENDM

;****************************************************************
;	MACRO: RF_BYTE_PUT
;	SEND A BYTE TO THE NRF
; 	ARGUMENT: BYTEVAL
;****************************************************************
RF_BYTE_PUT	MACRO	BYTEVAL	; CLOCK A BYTE OVER THE SPI
		MOVLW	BYTEVAL			; THE VALUE
		FARCALL	SPI_TRANSFER		; AND SEND IT
	ENDM

RD_NRF_BYTE	MACRO			
	MOVLW	NRF_NOP
	FARCALL	SPI_TRANSFER
	ENDM

m_INC_FAR_FILE	MACRO	FILEREG
	BANKSEL	FILEREG
	INCF	FILEREG
ENDM

FARCALL	MACRO	FUNCTION
	PAGESEL		FUNCTION
	CALL		FUNCTION
	PAGESEL	$
ENDM

m_IMMEDIATE_NRF_XT	MACRO	STRING_NAME
	MOVLW	HIGH	STRING_NAME
	MOVWF	BL_REG_PCLATH
	MOVLW	LOW	STRING_NAME
	MOVWF	TBL_START_PTR
	FARCALL	STRING_TO_NRF_XT
ENDM

m_IMMEDIATE_PRINTF	MACRO	STRING_NAME
	MOVLW	HIGH	STRING_NAME
	MOVWF	BL_REG_PCLATH
	MOVLW	LOW	STRING_NAME
	MOVWF	TBL_START_PTR
	FARCALL	IMMEDIATE_PRINTF
ENDM

LIST
;****************************************************************
;	MACRO: m_EEPROM_READ
; 	ARGUMENT: DATA_EE_ADDR (READS THIS ADDRESS)
;	CALLS:	EEPROM_READ	
;	RETURNS:  EEPROM DATA IN THE WREG
; 	AFFECTS: BANKSEL 0
;****************************************************************
m_EEPROM_READ	MACRO DATA_EE_ADDR	;m_EEPROM_READ	MACRO DATA_EE_ADDR
		MOVLW	0XF0				; 
		BANKSEL	EEADRH				; initialize EEADRH
		MOVWF	EEADRH
		MOVLW	DATA_EE_ADDR		; put eeprom address in WREG
		FARCALL	EEPROM_READ_W			; and read the eeprom at wreg
	ENDM



;****************************************************************
;	MACRO: m_EEPROM_WRITE	DATA_EE_ADDR, DATA_EE_DATA
; 	ARGUMENT: DATA_EE_ADDR, DATA_EE_DATA
;	CALLS:	EEPROM_WRITE
;	RETURNS: VOID
; 	AFFECTS: SETS BANK TO 0
;****************************************************************
m_EEPROM_WRITE	MACRO	DATA_EE_ADDR, DATA_EE_DATA
		BANKSEL EEADR ;
		MOVLW DATA_EE_ADDR ;
		MOVWF EEADR ;Data Memory Address to write
		MOVLW DATA_EE_DATA ;
		MOVWF EEDAT ;Data Memory Value to write
		FARCALL EEPROM_WRITE
	ENDM

m_EEPROM_WRITE_VERIFY	MACRO	DATA_EE_ADDR, DATA_EE_DATA, SKIP_LABEL
	m_EEPROM_WRITE	DATA_EE_ADDR, DATA_EE_DATA
	BANKSEL	EEDATA
	CLRF	EEDATA
	m_EEPROM_READ	DATA_EE_ADDR
	XORLW	DATA_EE_DATA
	BTFSC	STATUS,	Z
	GOTO	SKIP_LABEL
	m_IMMEDIATE_PRINTF	EEP_WT_ERR
;	CALL	PRINTF_EEPROM_WRITE_ERROR	
ENDM

;AS 3-5 BYTES WITH ALL 0XEF, FOR TX, & RX PIPES 0 AND 1 ONLY. AS 3-5 BYTES WITH ALL 0XEF
CONFIG_ADDRESS	MACRO ADD_REG, ADD0, ADD1, ADD2, ADD3, ADD4, RETURN_POINT 
	CSN_HI
	CSN_LO	

		m_EEPROM_READ	EE_SETUP_AW		; will be 1, 2, or 3, FOR 3, 4, or 5 bytes
		ADDLW	0x02					; need TO BE 3, 4 OR 5
		BANKSEL	COUNT_REG
		MOVWF	COUNT_REG		
		MOVLW	ADD_REG	| WRITE_REG
		FARCALL	SPI_TRANSFER			;INITIATE THE COMAND
		
		m_EEPROM_READ	ADD0		; MOVLW	ADD0			; GET THE VALUE OF THE LSBYTE OF THE ADDRESS
		FARCALL	SPI_TRANSFER			; AND SEND IT
		DECF	COUNT_REG
		SKIP_NOT_ZERO
		GOTO	RETURN_POINT			;	$+ .18
		m_EEPROM_READ	ADD1		; MOVLW	ADD1					; GET THE 2ND VALUE
		FARCALL	SPI_TRANSFER			; AND SEND IT
		DECF	COUNT_REG
		SKIP_NOT_ZERO
		GOTO	RETURN_POINT			; $+ .13
		m_EEPROM_READ	ADD2		; MOVLW	ADD2					; THE 3RD VALUE
		FARCALL	SPI_TRANSFER			; AND SEND IT
		DECF	COUNT_REG
		SKIP_NOT_ZERO
		GOTO	RETURN_POINT			; $+ .8
		m_EEPROM_READ	ADD3		; MOVLW	ADD3			; THE 4TH VALUE
		FARCALL	SPI_TRANSFER			; AND SEND IT
		DECF	COUNT_REG
		SKIP_NOT_ZERO
		GOTO	RETURN_POINT			; $+ .3
		m_EEPROM_READ	ADD4		; MOVLW	ADD4			; THE 5TH VALUE
		FARCALL	SPI_TRANSFER			; AND SEND IT
		CSN_HI
	ENDM		


m_EEPROM_TO_NRF_REG	MACRO	EEP_RGSTR,		NRF_RGSTR, 	NRF_SHADOW_REG
		m_EEPROM_READ		EEP_RGSTR		;m_EEPROM_READ	EEP_RGSTR
		m_WTW_NRF_REG		NRF_RGSTR		;WTW_NRF_REG		NRF_RGSTR	
		m_RD_NRF_REG		NRF_RGSTR,		NRF_SHADOW_REG	;		RD_NRF_REG		NRF_RGSTR,	NRF_SHADOW_REG
ENDM


;;;;;;;;;;;;;;;;;;;;;;;;;;;;;;;;;;;;;;;;;;
; MACRO: PRINTF
;	USAGE:	M_PRINTF	STRING_LABEL, STRING_VAL
;	FUNCTION: GENERATES A TABLE (AT COMPILE TIME) OF CHARS THAT MAKE IP THE STRING, AND CALLS 
;	USES:		BL_REG_PCLATH
;	
;;;;;;;;;;;;;;;;;;;;;;;;;;;;;;;;;;;;;;;;;;
PRINTF	MACRO	MSG_CALL,	MSG_STRING,	PCLATH_VAL
		MOVLW	HIGH(MSG_CALL)
		MOVWF	PCLATH			; for the "MOVWF	PCL" command
		banksel	COUNT_REG
		CLRF	COUNT_REG
;MSG_LOOP
		banksel	COUNT_REG
		INCF	COUNT_REG
		MOVLW	MSG_CALL
		ADDWF	COUNT_REG, W
		BTFSC	STATUS, C
		INCF	PCLATH
		CALL	MSG_CALL	; CANT FARCALL THIS!
		XORLW	0X03		; END OF TRANSMISSION
		SKIP_NOT_ZERO
		RETURN
		XORLW	0X03		; retrn WREG to its value befor the first x'or 3 lines back

		BANKSEL	NUUNBUFSTAT	; 
		BTFSC	NUUNBUFSTAT,	N2UBF
		GOTO	$-1
		FARCALL	UARTIntPutCh

		BANKSEL	NUUNBUFSTAT	; 
		PAGESEL	RESET_N2U_U2N_BUF		
		BTFSC	NUUNBUFSTAT,	N2UBOF
		FARCALL 	RESET_N2U_U2N_BUF		;  THIS SHOULDN'T OCCUR, BUT WILL...
		PAGESEL MacPRINT
		GOTO	$-.27			; GOTO MSG_LOOP. ADJUST AFTER EDITING THIS CODE
MSG_CALL
	MOVWF	PCL
	dt	MSG_STRING
	RETLW	0X0A		;NEWLINE
	RETLW	0X0D		;<CR>
	RETLW	0X03		;END OF TEXT
ENDM

;;;;;;;;;;;;;;;;;;;;;;;;;;;;;;;;;;;;;;;;;;
; MACRO: m_PRINTF
;	USAGE:	M_PRINTF	STRING_LABEL, STRING_VAL
;	FUNCTION: GENERATES A TABLE (AT COMPILE TIME) OF CHARS THAT MAKE IP THE STRING, AND CALLS 
;	USES:		BL_REG_PCLATH
;	
;;;;;;;;;;;;;;;;;;;;;;;;;;;;;;;;;;;;;;;;;;
; m_PRINTF	MACRO	MSG_CALL,	MSG_STRING,	PCLATH_VAL
;		MOVLW	PCLATH_VAL	
;		MOVWF	PCLATH			; for the "MOVWF	PCL" command
;	dt	MSG_STRING
;		MOVLW	HIGH MSG_STRING
;		MOVF	BL_REG_PCLATH
;		
;
;

#ENDIF
