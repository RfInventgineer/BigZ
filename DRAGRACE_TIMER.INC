
#IFNDEF	DRAGRACE_TIMER
#DEFINE	DRAGRACE_TIMER

LIST

sync_C2OUT		EQU	b'00000011'
sync_C1OUT		EQU	b'00000010'

; BITS FOR APP_STATUS_REG 
DR_STAGE_0		EQU	0X00		; RACE HASN'T STARTED, OR JUST STARTED
DR_STAGE_1		EQU	0X01		; CAR HAS REACHED THE 1ST SENSOR, TMR1 STARTED, START TMR4. UPDATE APP_STATUS<0..2> TO DR_STAGE_1
DR_STAGE_2		EQU	0X02		; CAR HAS PASSED THE 1ST SENSOR, TMR1 STOPPED.	STORE TMR1.
DR_STAGE_3		EQU	0X03		; CAR HAS REACHED THE 2ND SENSOR, TMR1 STARTED, STOP TMR4.
DR_STAGE_4		EQU	0X04		; CAR HAS PASSED THE 2ND SENSOR, TMR1 STOPPED. SUCCESS! REPORT RACE. CLR TIMR1. CLR TMR4.
DR_STAGE_5		EQU	0X05		; ERROR. DR_STAGE_2 WAS REACHED, AND A 2ND PULSE INTERRUPT FROM THE 1ST COMP. REPORT ERROR. A
DR_STAGE_6		EQU	0X06		; ERROR. DR_STAGE_2 WAS REACHED, AND A 2ND PULSE INTERRUPT FROM THE 2ND COMP. REPORT ERROR. 
DR_STAGE_7		EQU	0X07

;GLOBAL	DR_TIMER

DR_TIMER	UDATA	0X120
PULSE_PER1_L	RES	1
PULSE_PER1_H	RES	1
PULSE_PER1_HH	RES	1

;**********************************************************************************
;	DRAGRACE APP OVERVIEW
;		THIS APP MONITORS THE TIMING RELATIONSHIPS OF AND BETWEEN TWO PULSES 
;		GENERATED BY THE COMPARATOR 1 AND COMPARATOR 2 CIRCUITS, WHEN A 
;		MAGNET-EQUIPPED HOT-WHEELS CAR ROLLS OVER TWO DIFFERENT MAGNETIC SENSORS.
;		SEQUENCE IS AS FOLLOWS:
;
;		COMP1 OUT GOES - .... TMR1 STARTS. TMR4 STARTS. 
;		COMP1 OUT GOES + .... TMR1 STOPS. TMR1 VALUE IS READ, STORED, AND CLEARED.
;		COMP2 OUT GOES - .... TMR1 STARTS. TMR4 STOPS. 
;		COMP2 OUT GOES = .... TMR1 STOPS. TMR1 VALUE IS READ, STORED, AND CLEARED.
;							  TMR4'S VALUE IS READ, STORED, AND CLEARED.
;		ALL 3 TIMES (PER_1,PER_2, AND PULSE_SPACING) ARE REPORTED OVER BIGZ.
;**********************************************************************************

DRAGRACE	CODE ;0x38A


;**********************************************************************************
;	FUNCTION: DETERMINE INTERRUPT SOURCE AND RETUN APPROPRIATE VECTOR
;**********************************************************************************
DETERM_INT_SOURCE
  		BANKSEL	PIR2
  		BTFSC	PIR2,	C1IF	  		; CHECK FOR COMPARATOR INTERRUPT
  		RETLW	SERV_C1IF				;...
  		BTFSC	PIR2,	C2IF			;...
  		RETLW	SERV_C2IF				;...

  		BANKSEL	PIR1
  		BTFSC	PIR1,	TMR1IF			; CHECK FOR TMR1 INTERRUPT
  		RETLW	SERV_TMR1IF 			
 
  		BANKSEL	PIR3
  		BTFSC	PIR3,	TMR4IF			; CHECK FOR TMR3 INTERRUPT
  		RETLW	SERV_TMR4IF 			
   		CLRW
  	RETURN
;**********************************************************************************

;GLOBAL  DRAGRACE_INT_ISR

;**********************************************************************************
;	FUNCTION:  DRAGRACE_ISR
;	DESC:	RESPOND TO COMPARATOR PULSES AND TIMER1 INTERRUPTS
;			CAUSED WHEN CAR ROLLS OVER SENSORS
;**********************************************************************************
ORG	0X500
DRAGRACE_INT_ISR
		FARCALL	DETERM_INT_SOURCE	; RETURN APPROPO VECTOR IN WREG
  		BTFSC	STATUS,	Z			; IF NO ERROR,
	RETURN	;	NOT A COMPARATOR OR TIMER1 INTERRUPT
		BSF		CONFIG_STATUS_REG,	PIC_IN_NORMAL_MODE	; ONCE A DRAGRACE INT HAS OCCURED, DON'T ALLOW CONFIG MODE
		CALLW						; CALL THE APPROP SUB
		PAGESEL	$
	RETURN	;	NOT A COMPARATOR OR TIMER1 INTERRUPT
	
; COMPARATOR 2 INTERRUPT 
SERV_C2IF
		BANKSEL	CMOUT				; CHECK STATE 
		BTFSC	CMOUT,	MC2OUT		; OF C2OUT
		GOTO	RISING_EJ			; IF HI, ASSUME THE RISING EDGE TRIGGERED IT 
		FARCALL	FIRST_FALL_EDGE		; OTHERWISE, THE FALLING EDGE DID
	RETURN
RISING_EJ
		FARCALL	FIRST_RISE_EDGE
	RETURN
	
;*************************************************
; END OF STAGE 0, START OF STAGE 1 (RACE HAS STARTED)
;	GET TMR4 STARTED, THEN DO THE LESS TIME-SENSITIVE TASKS
;*************************************************
FIRST_FALL_EDGE			
	 	BANKSEL	T4CON
		BSF	T4CON,	TMR4ON								;  DO FIRST. TIME SENSITIVE
		FARCALL	SET_STAGE_1
	RETURN

;*************************************************
; END OF STAGE 1, START OF STAGE 2
;	TMR4 IS ALREADY RUNNING, WAITING FOR THE 2ND 
;	FALLING EDGE, SO THE ONLY THING TO DO HERE IS 
;	RECORD THE 1ST PULSE WIDTH, AND SET TMR1 TO 
;	BE GATED BY THE 2ND PULSE WHEN IT STARTS
;*************************************************
FIRST_RISE_EDGE					
		BANKSEL	T1CON				
		BCF		T1CON,	TMR1ON		; TURN TMR1 OFF
		BANKSEL	TMR1L			
		MOVFW	TMR1L
		MOVWF	CONFIG_ARG_1
		CLRF	TMR1L
		BANKSEL	TMR1H
		MOVFW	TMR1H
		MOVWF	CONFIG_ARG_2
		CLRF	TMR1H
		FARCALL	SET_STAGE_2		;SETSTAGE 2	SETS TMR1 UP FOR TIMING SECOND PULSE
	RETURN

SERV_C1IF
		BANKSEL	CMOUT
		BTFSC	CMOUT,	MC1OUT		;C2OUT
		GOTO	SEC_RISING_EJ
		FARCALL	SECOND_FALL_EDGE
	RETURN
SEC_RISING_EJ
		FARCALL	SECOND_RISE_EDGE
	RETURN

;*************************************************
; END OF STAGE 2, START OF STAGE 3
;	
SECOND_FALL_EDGE					
	 	BANKSEL	T4CON
		BCF	T4CON,	TMR4ON			; TURN TMR4 OFF.  DO FIRST. TIME SENSITIVE
		FARCALL	SET_STAGE_3
	RETURN
			
SECOND_RISE_EDGE					; END OF STAGE 3, START OF STAGE 4 (END OF RACE)
		BANKSEL	T1CON
		BCF		T1CON,	TMR1ON		;
		FARCALL	SET_STAGE_4
	RETURN
	
SERV_TMR1IF
		BANKSEL	TMR1_HH
		INCFSZ	TMR1_HH
		RETURN
		m_IMMEDIATE_NRF_XT	TMR1_HH_OVERFLOW
	RETURN

SERV_TMR4IF
		BANKSEL		PIR3
	 	BCF	PIR3,	TMR4IF			; CLEAR THE FLAG!!!
		BANKSEL	TMR6
		INCFSZ	TMR6
	RETURN
		BANKSEL	TMR2
		INCFSZ	TMR2
	RETURN
		m_IMMEDIATE_NRF_XT	TMR426_OVERFLOW
		FARCALL		REPORT_TIMES			;	YES. REPORT THE RESULTS,
		FARCALL		SET_STAGE_0				;	.....
	RETURN

SERV_TMR6IF
SERV_TMR2IF
DR_INT_STATUS_err
DR_STATUS_ERR_HANDLER
 		m_IMMEDIATE_NRF_XT	UNHANDLED_ERR		
	RETURN
	RESET

	RETURN
;,,,,,,,,,,,,,,,,,,,,,,,,,,,,,,,,,,,,,,,,,,,,,,,,,,,,,,,,,,,,,,,,,,,,,

;,,,,,,,,,,,,,,,,,,,,,,,,,,,,,,,,,,,,,,,,,,,,,,,,,,,,,,,,,,,,,,,,,,,,,
;		DRAGRACE ROUTINE
;,,,,,,,,,,,,,,,,,,,,,,,,,,,,,,,,,,,,,,,,,,,,,,,,,,,,,,,,,,,,,,,,,,,,,

DRAGRACE_ROUTINE
;,,,,,,,,,,,,,,,,,,,,,,,,,,,,,,,,,,,,,,,,,,,,,,,,,,,,,,,,,,,,,,,,,,,,,
;	SET UP FOR DRAGRACE TIMER APP, UNLESS IT'S JUST THE DRAGRACE RECEIVER,
;		IN WHICH CASE IT'S JUST A BigZ.
;,,,,,,,,,,,,,,,,,,,,,,,,,,,,,,,,,,,,,,,,,,,,,,,,,,,,,,,,,,,,,,,,,,,,,
	m_EEPROM_READ	DRAGSTER_FLAGS
	BANKSEL			APPLICATION_FLAGS
	movwf			APPLICATION_FLAGS
	XORLW			DRAGSTER_RCVR
	SKIP_IF_ZERO
	GOTO			NOT_JUST_A_BigZ
	MOVLW			BigZ_APP				;	THAT'S ALL THE RECEIVER WILL BE, AT LEAST FOR NOW
	
NOT_JUST_A_BigZ
	PAGESEL			SETUP_FOR_DRAGRACE
	CALL			SETUP_FOR_DRAGRACE
	PAGESEL			$
	MOVLW			DR_STAGE_0
	MOVWF			BKLS_REG3
;,,,,,,,,,,,,,,,,,,,,,,,,,,,,,,,,,,,,,,,,,,,,,,,,,,,,,,,,,,,,,,,,,,,,,
;	SET UP INTERRUPT VECTOR FOR DRAGRACE APP
;,,,,,,,,,,,,,,,,,,,,,,,,,,,,,,,,,,,,,,,,,,,,,,,,,,,,,,,,,,,,,,,,,,,,,
	MOVLW	DRAGRACE_ISR
	BANKSEL	APP_INT_ISR_VECTOR
	MOVWF	APP_INT_ISR_VECTOR	; MAKE DRAGRACE ISR THE INTERRUPT VECTOR
;,,,,,,,,,,,,,,,,,,,,,,,,,,,,,,,,,,,,,,,,,,,,,,,,,,,,,,,,,,,,,,,,,,,,,
;,,,,,,,,,,,,,,,,,,,,,,,,,,,,,,,,,,,,,,,,,,,,,,,,,,,,,,,,,,,,,,,,,,,,,
	BSF			INTCON,		GIE		; ENABLE INTERRUPTS
    bsf     	INTCON,		PEIE     ;Enable Peripheral Interrupt
;,,,,,,,,,,,,,,,,,,,,,,,,,,,,,,,,,,,,,,,,,,,,,,,,,,,,,,,,,,,,,,,,,,,,,

	m_IMMEDIATE_NRF_XT	Start_Your_Engines

DRAGRACE_LOOP
		FARCALL		NRF_DATA_HANDLER
		MOVLW		DR_STAGE_4				;	HAS A RACE JUST FINISHED?
		XORWF		APP_STATUS_REG,	W		;	...
		BTFSS		STATUS,	Z				;	?
		GOTO		DRAGRACE_LOOP			;	NO. REPEAT
		CALL		REPORT_TIMES			;	YES. REPORT THE RESULTS,
		CALL		SET_STAGE_0				;	.....
		GOTO		DRAGRACE_LOOP			;	REPEAT
	RETURN
	
REPORT_TIMES
		FARCALL		NRF_DATA_HANDLER
		m_IMMEDIATE_NRF_XT	PULSE_W_1
		FARCALL		HEXTONRF_PREFIX
		MOVFW		CONFIG_ARG_2
		FARCALL		HEXTONRF_RAW
		MOVFW		CONFIG_ARG_1
		FARCALL		HEXTONRF_RAW
		FARCALL		CR_LF_TO_NRF
		FARCALL		NRF_DATA_HANDLER
			
		m_IMMEDIATE_NRF_XT	PULSE_W_2	
		FARCALL		HEXTONRF_PREFIX
		BANKSEL		TMR1H
		MOVFW		TMR1H
		FARCALL		HEXTONRF_RAW
		BANKSEL		TMR1L
		MOVFW		TMR1L
		FARCALL		HEXTONRF_RAW
		FARCALL		CR_LF_TO_NRF
		FARCALL		NRF_DATA_HANDLER

		
		
;		FARCALL		NRF_DATA_HANDLER
		m_IMMEDIATE_NRF_XT	PUSLE_SPACING
		FARCALL		HEXTONRF_PREFIX
		BANKSEL		TMR2
		MOVFW		TMR2
		FARCALL		HEXTONRF_RAW
		BANKSEL		TMR6
		MOVFW		TMR6
		FARCALL		HEXTONRF_RAW
		BANKSEL		TMR4
		MOVFW		TMR4
		FARCALL		HEXTONRF_RAW
		FARCALL		CR_LF_TO_NRF
		FARCALL		NRF_DATA_HANDLER
	RETURN
;--------------------------------------------------------------------------
;-----------END OF DRAGRACE_ROUTINE----------------------------------------
;--------------------------------------------------------------------------

SET_STAGE_0		;	IDLE. WAIT FOR RACE pending
;		CALL	TMR1_CLR
;		CALL	TMR2_6_CLR
		FARCALL	SETUP_FOR_DRAGRACE
		CALL	DRAG_RACE_INTERRUPTS_ON
		MOVLW	DR_STAGE_0
		GOTO	UPDATE_STAGE_STATUS_W	

SET_STAGE_1						; First comp falling edge
		BANKSEL	PIR2
		BCF		PIR2,	C2IF
		MOVLW	DR_STAGE_1
		GOTO	UPDATE_STAGE_STATUS_W	
	
SET_STAGE_2						; FIRST PULSE HAS ENDED.
		BANKSEL	PIR2
		BCF		PIR2,	C2IF
		CALL	STORE_TMR1			; STORE	TMR RESULTS
		CALL	TMR1_TOG_GATE_SRC	; PREPARE FOR THE 2ND PULSE
		CALL	TMR1_CLR
		BSF		T1CON,	TMR1ON		; 1 = TURN TMR1 ON. SINCE IT IS GATED BY COMP2 OUT = LOW, IT SHOULDNT START COUNTING YET
		MOVLW	DR_STAGE_2
		GOTO	UPDATE_STAGE_STATUS_W	
		
SET_STAGE_3		; SECOND PULSE STARTED. TMR1 WAS SET UP IN SET_STAGE_2, SO JUST CLEAR INTERRUPT
		BANKSEL	PIR2
		BCF		PIR2,	C1IF
		MOVLW	DR_STAGE_3
		GOTO	UPDATE_STAGE_STATUS_W	

SET_STAGE_4		; SECOND PULSE ENDED. RACE COMPLETE!
		BANKSEL	T1CON
		BCF		T1CON,	TMR1ON				; 0 = TURN TMR1 OFF
		BANKSEL	PIR2						;
		BCF		PIR2,	C1IF				;
		CALL	DRAG_RACE_INTERRUPTS_OFF	;
		MOVLW	DR_STAGE_4					;
		GOTO	UPDATE_STAGE_STATUS_W		;	
	
SET_STAGE_5		; ERROR CONDITION
		MOVLW	DR_STAGE_5	
		GOTO	UPDATE_STAGE_STATUS_W	

SET_STAGE_6		; ERROR CONDITION
		MOVLW	DR_STAGE_6
		GOTO	UPDATE_STAGE_STATUS_W	

SET_STAGE_7		; ERROR CONDITION
		MOVLW	DR_STAGE_7
		GOTO	UPDATE_STAGE_STATUS_W	

UPDATE_STAGE_STATUS_W
		MOVWF	APPLICATION_TEMP
		MOVFW	APP_STATUS_REG
		ANDLW	0XF0
		IORWF	APPLICATION_TEMP,W
		MOVWF	APP_STATUS_REG
		MOVFW	APPLICATION_TEMP
LEAVE_SETSTAGE
	#IFDEF	VERBOSE
		MOVWF	APPLICATION_TEMP	
		m_IMMEDIATE_NRF_XT  Stage
		FARCALL	HEXTONRF	;WREG_TO_UTON_BUFFER
	#ELSE
		BANKSEL	TEMP1
        MOVWF   TEMP1
		CALL	SAFE_UTON_BUFF_APPEND
	#ENDIF
	RETURN	
		
;****************************************************
STORE_TMR1
		BANKSEL	TMR1
		MOVFW	TMR1L
		BANKSEL	PULSE_PER1_L
		MOVWF	PULSE_PER1_L
		BANKSEL	TMR1
		MOVFW	TMR1H
		BANKSEL	PULSE_PER1_H
		MOVWF	PULSE_PER1_H
		BANKSEL	TMR1_HH
		MOVFW	TMR1_HH
		BANKSEL	PULSE_PER1_HH
		MOVWF	PULSE_PER1_HH
	RETURN

;**********************************************************************************
;	FUNCTION:	SETUP_FOR_DRAGRACE
;	DESC:	SETS UP THE COMPARATORS, TIMERS, AND INTERRUPTS NEEDED
;			IN THE DRAGRACE TIMER APP.
;**********************************************************************************
SETUP_FOR_DRAGRACE

	CALL	DRAG_RACE_INTERRUPTS_OFF	; TIL THINGS ARE SET UP
;	SETUP Comparators
	FARCALL	COMP1_ENABLE
	FARCALL	COMP2_ENABLE
	CALL	INIT_DRAGRACE_TMR1
	CALL	INIT_DRAGRACE_TMR2_4_6
	CALL	DRAG_RACE_INTERRUPTS_ON
	CLRF	APP_STATUS_REG
	RETURN
	
;**********************************************************************************
;	FUNCTION:	DRAG_RACE_INTERRUPTS_OFF
;		DESC:	CLEAR/DISABLE INTERRUPTS
;		
;**********************************************************************************
;GLOBAL DRAG_RACE_INTERRUPTS_OFF
DRAG_RACE_INTERRUPTS_OFF
;	CLEAR/DISABLE COMPARATOR INTERRUPS	
	BANKSEL	PIR2
	BCF		PIR2,	C1IF
	BCF		PIR2,	C2IF
	BANKSEL	PIE2
	BCF		PIE2,	C1IE
	BCF		PIE2,	C2IE
	
;	CLEAR/DISABLE TIMER1 INTERRUPS		
	BANKSEL	PIE1
	BCF		PIE1,	TMR1GIE
	BANKSEL	PIR1
	BCF		PIR1,	TMR1GIF
	;	DIABLE TIMER1/2 INTERRUPS		
	BCF		PIE1,	TMR1IE
	BCF		PIE1,	TMR2IE
	BANKSEL	PIR1
	BCF		PIR1,	TMR1IF
	BCF		PIR1,	TMR2IF

;	ENABLE TIMR4/6 INTERRUPS		
	BANKSEL	PIE3
	BCF		PIE3,	TMR4IE
	BCF		PIE3,	TMR6IE
	BANKSEL	PIR3
	BCF		PIR3,	TMR4IF
	BCF		PIR3,	TMR6IF
 RETURN
 
;**********************************************************************************
;	FUNCTION:	DRAG_RACE_INTERRUPTS_ON
;		DESC:	ENABLE INTERRUPTS
;		
;**********************************************************************************
GLOBAL DRAG_RACE_INTERRUPTS_ON
DRAG_RACE_INTERRUPTS_ON:
;	ENABLE COMPARATOR INTERRUPS	
	BANKSEL	PIR2
	BCF		PIR2,	C1IF
	BCF		PIR2,	C2IF
	BANKSEL	PIE2
	BSF		PIE2,	C1IE
	BSF		PIE2,	C2IE
	
;	ENABLE TIMER1 INTERRUPT
	BANKSEL	PIR1
	BCF		PIR1,	TMR1IF
	BCF		PIR1,	TMR2IF
	BANKSEL	PIE1
	BSF		PIE1,	TMR1IE
;	BSF		PIE1,	TMR2IE

;	ENABLE TIMR4/6 INTERRUPS		
	BANKSEL	PIR3
	BCF		PIR3,	TMR4IF
	BCF		PIR3,	TMR6IF
	BANKSEL	PIE3
	BSF		PIE3,	TMR4IE
;	BSF		PIE3,	TMR6IE
 RETURN
 
;**********************************************************************************
;	FUNCTION:	INIT_DRAGRACE_TMR1
;	DESC:	SETUP ROUTINE FOR TIMER 1
;	WITH A XTAL OF 16MHz
;	PUTTING TMR1CS<1:0> = 00 DIVIDES THE 16MHz BY 4, 
;	PUTTING T1CKPS<1:0> = 11 DIVIDE THE 4MHz BY 4, GIVES A 1MHz COUNT RATE
;	
;**********************************************************************************
 INIT_DRAGRACE_TMR1
 	BANKSEL	T1CON
	BCF	T1CON,	TMR1CS0			;'0' SELECTS FOSC/4 Internal Clock
	BCF	T1CON,	TMR1CS1			;

	MOVLW	b'00110000'			; SET PRESCALE TO 8. BITS 4&5: 00=1:1, 01=1:2,10=1:4,11=1:8
	IORWF	T1CON				; ...

	BCF		T1CON,	NOT_T1SYNC	; 1 = Do not synchronize external clock input
								; 0 = Synchronize external clock input with system clock (FOSC)
  	FARCALL	TMR1_CLR			; 
  	FARCALL	TMR1_GATE_COMP2_LOW
	BSF		T1CON,	TMR1ON		; 1 = TURN TMR1 ON
  RETURN

TMR1_SET_PRESCALE
	RETURN

TMR1_GATE_COMP2_LOW
		BANKSEL	T1GCON
		MOVLW	sync_C1OUT	
		IORWF	T1GCON,	F
		BSF		T1GCON,	TMR1GE		; ENABLE GATING
		BCF		T1GCON,	T1GPOL		; 0 = Timer1 gate is active-low (Timer1 counts when gate is low)
		BCF		T1GCON,	T1GTM		; 0 = Timer1 Gate Toggle mode is disabled and toggle flip flop is cleared
		BCF		T1GCON,	T1GSPM		; 0 = Timer1 gate Single-Pulse mode is disabled 
		BSF		T1GCON,	T1GSS0		;\
		BSF		T1GCON,	T1GSS1		; > GATE SOURCE...11 = Comparator 2 optionally synchronized output (SYNCC2OUT)
	RETURN								;/

	
TMR1_TOG_GATE_SRC
		BANKSEL	T1GCON
		MOVLW	b'01'
		XORWF	T1GCON
	RETURN

TMR1_CLR
	BANKSEL	TMR1H
	CLRF	TMR1H
	BANKSEL	TMR1L
	CLRF	TMR1L  
  RETURN

;**********************************************************************************
;	FUNCTION:	SET_UP_DRAGRACE_TMR4
;	DESC:	SETUP ROUTINE FOR TIMER 4
;	
;**********************************************************************************
 INIT_DRAGRACE_TMR2_4_6
	CALL	TMR2_OFF
	CALL	TMR2_CLR
	CALL	TMR4_OFF
	CALL	TMR4_CLR
	CALL	TMR6_OFF
	CALL	TMR6_CLR
	
	BCF	T4CON,	T4OUTPS0	;'0' SELECTS FOSC/4 Internal Clock
	BCF	T4CON,	T4OUTPS1	;
	; SET PRESCALE. 00=1:1, 01=1:2,10=1:4,11=1:8
	BSF	T4CON,	T4CKPS1		; T1CKPS<1>....WHEN SET, PRESCALE CLOCK IS 1:8 OR 1:4\
	BSF	T4CON,	T4CKPS0		; T1CKPS<0>....WHEN SET, PRESCALE CLOCK IS 1:2 OR 1:8>\ b'11 = 1:8
  RETURN
  
  
TMR2_OFF  
	 	BANKSEL	T2CON
		BCF	T2CON,	TMR2ON
	RETURN

TMR2_ON
	 	BANKSEL	T2CON
		BSF	T2CON,	TMR2ON
	RETURN

TMR2_CLR
		BANKSEL	TMR2
		CLRF	TMR2
	RETURN

TMR4_ON  
	 	BANKSEL	T4CON
		BSF	T4CON,	TMR4ON
	RETURN

TMR4_OFF  
	 	BANKSEL	T4CON
		BCF	T4CON,	TMR4ON
	RETURN

TMR4_CLR
		BANKSEL	TMR4
		CLRF	TMR4
	RETURN

TMR6_OFF
	 	BANKSEL	T6CON
		BCF	T6CON,	TMR6ON
	RETURN

TMR6_CLR
		BANKSEL	TMR6
		CLRF	TMR6
	RETURN

#ENDIF