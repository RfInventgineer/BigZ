
#IFNDEF	Tables
#define	Tables

;org	0xF30
Tables_code	CODE	0xB80

;---------------------------------------------------------------------------------------------
;---------------------------------------------------------------------------------------------
;	FUNCTION: 	 GET_BYTE_W_FROM_TABLE
;	DESCRIPTION: GETS CHARACTER AT POSITION <WREG>, IN ARRAY STARTING AT THE
;					ADDRESS <TBL_START_PTR>, ON PAGE <BL_REG_PCLATH>, AND RETURNS THE BYTE IN THE WREG. 
;	PREREQUISITE: WREG, TBL_START_PTR, AND BL_REG_PCLATH MUST BE INITIALIZED WITH THE LOCATION 
;					OF THE MESSAGE ARRAY.
;	AFFECTS: PCLATH, WREG, STATUS
;	NOTE!!!  PCLATH NEEDS TO BE ADJUSTED AFTER CALLING GET_TABLE_BYTE
;---------------------------------------------------------------------------------------------
GET_BYTE_W_FROM_TABLE
	MOVWF	TABLE_POSITION_PTR
;---------------------------------------------------------------------------------------------
;---------------------------------------------------------------------------------------------
;	FUNCTION: 	 GET_BYTE_W_FROM_TABLE
;	DESCRIPTION: GETS CHARACTER AT POSITION <TABLE_POSITION_PTR>, IN ARRAY STARTING AT THE
;					ADDRESS <TBL_START_PTR>, ON PAGE <BL_REG_PCLATH>, AND RETURNS THE BYTE IN THE WREG. 
;	PREREQUISITE: TABLE_POSITION_PTR, TBL_START_PTR, AND BL_REG_PCLATH MUST BE INITIALIZED WITH THE LOCATION 
;					OF THE MESSAGE ARRAY.
;	AFFECTS: PCLATH, WREG, STATUS
;	NOTE!!!  PCLATH NEEDS TO BE ADJUSTED AFTER CALLING GET_TABLE_BYTE
;---------------------------------------------------------------------------------------------
GET_TABLE_BYTE
	MOVFW	BL_REG_PCLATH		
	MOVWF	PCLATH					;PAGESELW	GET_TABLE_BYTE	; SET PCLATH PRIOR TO THE "MOVWF PCL" COMMAND
;---------------------------------------------------------------------------------------------
;	FUNCTION: 	 GET_TABLE_BYTE_PCLATH_SET
;	DESCRIPTION: GETS CHARACTER AT POSITION <TABLE_POSITION_PTR>, IN ARRAY STARTING AT THE
;					ADDRESS <TBL_START_PTR>, ON PAGE <PCLATH>, AND RETURNS THE BYTE IN THE WREG. 
;	PREREQUISITE: TABLE_POSITION_PTR, TBL_START_PTR, MUST BE INITIALIZED WITH THE LOCATION 
;					OF THE MESSAGE ARRAY.
;	AFFECTS: WREG, STATUS
;	NOTE!!!  PCLATH NEEDS TO BE ADJUSTED AFTER CALLING GET_TABLE_BYTE
;---------------------------------------------------------------------------------------------
GET_TABLE_BYTE_PCLATH_SET:
	MOVFW	TBL_START_PTR	
	ADDWF	TABLE_POSITION_PTR, W
	BTFSC	STATUS,	C
	INCF	PCLATH
	MOVWF	PCL				;	THIS SHOULD ALWAYS BE A LOCATION WITH A RETLW INSTRUCTION
	RESET				;SHOULD NEVER GET HERE

IM_ALIVE	
dt	"READY!",0X0A, 0X0D, 0X03

NRF_RXD_DATA
dt	"DATS REC'D.",0X0A, 0X0D, 0X03

TX_FIFO_OVERFLOW
dt "TX_FIFO_OF!",0X0A, 0X0D, 0X03

Start_Your_Engines
dt "START YOUR ENGINES!",0X0A, 0X0D, 0X03

RACE_IN_PROCESS
dt "Race In Progress:",0X0A, 0X0D, 0X03

UNHANDLED_ERR
dt "UNHAND_ERROR!",0X0A, 0X0D, 0X03

RACE_STATUS
dt "RCSTAGE:",0X03

INTERRUPT_SOURCE
DT "INT SRC:", 0X03

TMR1_HH_OVERFLOW
dt "TMR1_HH OVF!",0X0A, 0X0D, 0X03

TMR426_OVERFLOW
dt "TMR426 OVF!",0X0A, 0X0D, 0X03

PULSE_W_1
dt	"1ST PW:",	0X03

PULSE_W_2
dt	"2ND PW:",	0X03

USS
dt	" uSec",0X0A, 0X0D, 0X03

PUSLE_SPACING
dt	"PUSLE SPACE (FALLING EDGE):",   0X03
	
Stage
dt  "STAGE", 0X03
Stage_1
dt  "STG1",0X0A, 0X0D, 0X03
Stage_2
dt  "STG2",0X0A, 0X0D, 0X03
Stage_3
dt  "STG3",0X0A, 0X0D, 0X03
Stage_4
dt  "STG4",0X0A, 0X0D, 0X03
Stage_5
dt  "STG5",0X0A, 0X0D, 0X03
Stage_6
dt  "STG6",0X0A, 0X0D, 0X03

CONFIG_KEY
dt "UUU_BZ_Config"

CONFIG_INTRO
dt "Config Mode.", 0X0A, 0X0D, 0X03

tbl_of_Tbl_Pointers_To_REG_NAMES:	;	FOR PRINTF REPORTING, THESE POINT TO THE LOW ADDRESSE OF THE STRING TABLES ARE
dt	low(tblCONFIG), LOW(tblEN_AA), LOW(tblEN_RXADDR), LOW(tblSETUP_AW), LOW(tblSETUP_RETR)
dt	LOW(tblRF_CH), LOW(tblRF_SETUP), LOW(tblRF_STATUS), LOW(tblOBSERVE_TX), LOW(tblRPD)
dt	LOW(tblNRF_DYNPD), LOW(tblNRF_FEATURE), LOW(tblRX_ADDR_P0), LOW(tblRX_ADDR_P1), LOW(tblRX_ADDR_P2)
dt	LOW(tblTX_ADDR), LOW(tblRX_PW_P0), LOW(tblRX_PW_P1), LOW(tblRX_PW_P2), LOW(tblFIFO_STATUS)
dt	LOW(tblRX_ADDR_P3), LOW(tblRX_ADDR_P4), LOW(tblRX_ADDR_P5)

tbl_of_Tbl_Pg_Ptrs_To_REG_NAMES:	; FOR PRINTF REPORTING, THESE POINT TO THE CODE PAGE THAT STRING TABLES ARE
dt	HIGH(tblCONFIG), HIGH(tblEN_AA), HIGH(tblEN_RXADDR), HIGH(tblSETUP_AW), HIGH(tblSETUP_RETR)
dt	HIGH(tblRF_CH), HIGH(tblRF_SETUP), HIGH(tblRF_STATUS), HIGH(tblOBSERVE_TX), HIGH(tblRPD)
dt	HIGH(tblNRF_DYNPD), HIGH(tblNRF_FEATURE), HIGH(tblRX_ADDR_P0), HIGH(tblRX_ADDR_P1), HIGH(tblRX_ADDR_P2)
dt	HIGH(tblTX_ADDR), HIGH(tblRX_PW_P0), HIGH(tblRX_PW_P1), HIGH(tblRX_PW_P2), HIGH(tblFIFO_STATUS)
dt	HIGH(tblRX_ADDR_P3), HIGH(tblRX_ADDR_P4), HIGH(tblRX_ADDR_P5)

tbl_GHOST_REG_VALS:	; THESE ARE THE ADDRESSES IN THE PIC 
dt	LOW(NRF_CONFIG), LOW(NRF_EN_AA), LOW(NRF_EN_RXADDR), LOW(NRF_SETUP_AW), LOW(NRF_SETUP_RETR)
dt	LOW(NRF_RF_CH), LOW(NRF_RF_SETUP), LOW(NRF_STATUS), LOW(NRF_OBSERVE_TX), LOW(NRF_RPD)
dt	LOW(NRF_DYNPD), LOW(NRF_FEATURE), LOW(NRF_RX_ADDR_P0), LOW(NRF_RX_ADDR_P1), LOW(NRF_RX_ADDR_P2)
dt	LOW(NRF_TX_ADDR), LOW(NRF_RX_PW_P0), LOW(NRF_RX_PW_P1), LOW(NRF_RX_PW_P2), LOW(NRF_FIFO_STATUS)
dt	LOW(NRF_RX_ADDR_P3), LOW(NRF_RX_ADDR_P4), LOW(NRF_RX_ADDR_P5)

tblCONFIG:
dt	"CONFIG REG:", 0X03
tblEN_AA
dt "EN_AA:", 0X03

tblEN_RXADDR 			
dt "EN_RXADDR:", 0X03	;ENABLED RX ADDRESSES
tblSETUP_AW
dt "SETUP_AW:", 0X03		;SETUP OF ADDRESS WIDTHS(COMMON FOR ALL DATA PIPES)
tblSETUP_RETR
dt "SETUP_RETR:", 0X03		;SETUP OF AUTOMATIC RETRANSMISSION
tblRF_CH 					;RF CHANNEL
dt	"RF_CH:", 0X03
tblRF_SETUP 				;RF SETUP REGISTER
dt	"RF_SETUP:", 0X03
tblRF_STATUS 				;STATUS REGISTER (
dt	"RF_STATUS:", 0X03
tblOBSERVE_TX 				;TRANSMIT OBSERVE REGISTER
dt	"OBSERVE_TX:", 0X03
tblRPD						;RECEIVED POWER DETECT (BIT 0)
dt	"RPD:", 0X03

tblNRF_DYNPD						;RECEIVED POWER DETECT (BIT 0)
dt	"DYNPD:", 0X03
tblNRF_FEATURE						;RECEIVED POWER DETECT (BIT 0)
dt	"RRF_FEATURE:", 0X03
tblFIFO_STATUS
dt	"FIFO_STATUS:", 0X03


tblRX_ADDR_P0
dt	"RX_ADDR_P0:", 0X03
tblRX_ADDR_P1
dt	"RX_ADDR_P1:", 0X03
tblRX_ADDR_P2
dt	"RX_ADDR_P2:", 0X03
tblRX_ADDR_P3
dt	"RX_ADDR_P3:", 0X03
tblRX_ADDR_P4 	
dt  "RX_ADDR_P4:", 0X03
tblRX_ADDR_P5 	
dt  "RX_ADDR_P5:", 0X03

tblTX_ADDR   	
dt  "TX_ADDR:", 0X03
tblRX_PW_P0 	
dt  "RX_PW_P0:", 0X03
tblRX_PW_P1 	
dt  "RX_PW_P1:", 0X03
tblRX_PW_P2 	
dt  "RX_PW_P2:", 0X03
tblRX_PW_P3 	
dt  "RX_PW_P3:", 0X03
tblRX_PW_P4 	
dt  "RX_PW_P4:", 0X03

tblSPISTATUS
dt  "SPISTATUS:", 0X03


HELP_RESPONSE:
dt	"READ ""EEPROM_CONFIG.INC.""", 0X0A, 0X0D, 0X03

EEP_WT_ERR:
dt	"EE WT ERR.",0X0A,0X0D,0X03

NRF_REG_MAP_START	
dt 0X0, 0x1, 0x2,0x3,0x4, 0x5, 0x6,0x7, 0x8, 0x9, 0x17, 0x1c, 0x1d, 0XC,0XD,0XE,0XF,0X11,0X12,0X13,0X14,0X15,0X16
NRF_REG_MAP_END

NRF_SHADOW_MAP_START	;	
dt	0X30,0X31,0X32,0X33,0X34,0X35,0X36,0X37,0X38,0X39,0X53,0X58,0X59,0X44,0X45,0X46,0X47,0X4D,0X4E,0X4F,0X50,0X51,0X52,0X53
NRF_SHADOW_MAP_END

MAX_RT
dt	"MX_RT",0X0A,0X0D,0X03
TX_SUCCESS:
dt	"TX ACKD.",0X0A,0X0D,0X03
RECIEVER_DR
dt	"RX_DR.", 0X0A,0X0D,0X03

tbl_MULTI_BYTE_NRF_REGISTERS
dt	TX_ADDR,RX_ADDR_P1,RX_ADDR_P0

tbl_MULTI_BYTE_NRF_SHADOW_REGS	
dt	LOW NRF_TX_ADDR,LOW NRF_RX_ADDR_P1,LOW NRF_RX_ADDR_P0

;------------------tables--------------------------------
;
;TBL	CODE	;	0x920
;org	0x900

MacPRINT

PRINTF_TX_SUCCESS
	m_IMMEDIATE_PRINTF TX_SUCCESS
	RETURN

PRINTF_RX_DR
	m_IMMEDIATE_PRINTF RX_DR	
	RETURN

PRINTF_MAX_RT
	m_IMMEDIATE_PRINTF MAX_RT
	RETURN
;
PRINTF_NRF_STATUS
	PRINTF NRF_STATUS_ptr, "NRF_STATUS", 0X09
	RETURN
	
PRINTF_UNKNOWN_FAILURE
	PRINTF UNKN_FAILURE, "UNKNOWN_INTERRUPT", 0X09
	RETURN
	
PRINTF_BUFFER_RESET
;	PRINTF	BUFFER_RESET,	"BUF RESET", 0X09
	RETURN

PRINTF_WAITING_FOR_CLOCK
;	PRINTF WAITING_FOR_CLOCK, "WAITIN 4 CLOCK", 0X09
   RETURN

PRINTF_SPI_STATUS_BIT_ERROR
;	m_PRINTF	SPI_STAT_BIT_ERR, "SPI STAT BIT ERR", 0X0C
;	REGISTER_TO_SCREEN	tblSPISTATUS,	NRF_STATE_REG
	RETURN	

PRINTF_RX_FIFO_OVERFLOW
; 	m_PRINTF RX_FIFO_OVERFLOW, "RX FIFO OFLOW-FLUSHED", 0X0C
	RETURN

;PRINTF_TX_OVERFLOW	
;	m_PRINTF TX_FIFO_OVERFLOW, "TX_FIFO_OF", 0X0C
;	RETURN

;PRINTF_PORTS_A_B_D
;	#IFDEF REPORT_PORT_A
;		REGISTER_TO_SCREEN	tblPORTA, PORTA
;	#ENDIF
;	#IFDEF REPORT_PORT_B
;		REGISTER_TO_SCREEN	tblPORTB, PORTB
;	#ENDIF
;	#IFDEF REPORT_PORT_C
;		REGISTER_TO_SCREEN	tblPORTC, PORTC
;	#ENDIF
;RETURN	




;m_IMMEDIATE_PRINTF		tblCONFIG
;	REGISTER_TO_SCREEN	tblCONFIG,		NRF_CONFIG
;	REGISTER_TO_SCREEN	tblEN_AA,		NRF_EN_AA			;STARTING ADDRESS OF THE NRF REGISTERS
;	REGISTER_TO_SCREEN	tblEN_RXADDR,	NRF_EN_RXADDR 	
;	REGISTER_TO_SCREEN	tblSETUP_AW,	NRF_SETUP_AW	
;	REGISTER_TO_SCREEN	tblSETUP_RETR,	NRF_SETUP_RETR	
;	REGISTER_TO_SCREEN	tblRF_CH,		NRF_RF_CH 		
;	REGISTER_TO_SCREEN	tblRF_SETUP, 	NRF_RF_SETUP 	;RF SETUP REGISTER
;	REGISTER_TO_SCREEN	tblRF_STATUS, 	NRF_STATUS 	;STATUS REGISTER (
;	REGISTER_TO_SCREEN	tblOBSERVE_TX, 	NRF_OBSERVE_TX 	;TRANSMIT OBSERVE REGISTER
;	REGISTER_TO_SCREEN	tblRPD,			NRF_RPD			;RECEIVED POWER DETECT (BIT 0)
;	REGISTER_TO_SCREEN	tblNRF_DYNPD,	NRF_DYNPD
;	REGISTER_TO_SCREEN	tblNRF_FEATURE,	NRF_FEATURE
;
;	REGISTER_TO_SCREEN	tblRX_ADDR_P0,	NRF_RX_ADDR_P0 	
;	REGISTER_TO_SCREEN	tblRX_ADDR_P1,	NRF_RX_ADDR_P1 	
;	REGISTER_TO_SCREEN	tblRX_ADDR_P2,	NRF_RX_ADDR_P2 	
;	REGISTER_TO_SCREEN	tblTX_ADDR,   	NRF_TX_ADDR   	
;	REGISTER_TO_SCREEN	tblRX_PW_P0, 	NRF_RX_PW_P0 	
;	REGISTER_TO_SCREEN	tblRX_PW_P1, 	NRF_RX_PW_P1 							
;	REGISTER_TO_SCREEN	tblRX_PW_P2, 	NRF_RX_PW_P2 	
;	REGISTER_TO_SCREEN	tblFIFO_STATUS,	NRF_FIFO_STATUS
;	RETURN		
#ENDIF