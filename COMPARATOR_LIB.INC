LIST

;ORG	0X640
COMPARE_MODULE	CODE	;0X640
;	FILENAME: COMPARATOR_LIB.INC
;	DESC: BASIC SETUP ROUTINE
;*****************************************************************
;*****************************************************************
; FUNCTION: COMP1_INIT
;*****************************************************************
COMP1_ENABLE
		BANKSEL		TRISA
		BCF			TRISA,		RA4
		BANKSEL		ANSELA
		MOVLW		0X0F
		IORWF		ANSELA,F			; INSURES THE COMPARATOR INPUTS ARE SET TO ANALOG
	
		BANKSEL		CM1CON1
		BCF			CM1CON1,	C1NCH0	;\
		BCF			CM1CON1,	C1NCH1	;/  SELECTS PIN 2 OF PIC FOR COMP1'S NEG INPUT
		BCF			CM1CON1,	C1PCH0	;\
		BCF			CM1CON1,	C1PCH1	;/  SELECTS PIN 5 OF PIC FOR COMP1'S POS INPUT
		BSF			CM1CON1,	C1INTN	; INTERRUPT WHEN COMP1 OUT GOES NEGATIVE.
		BSF			CM1CON1,	C1INTP	; OR POSITIVE
	
		BANKSEL		CM1CON0
		BSF			CM1CON0,	C1SYNC	; 1 = SYNC MODE
		BCF			CM1CON0,	C1HYS	; 0 = DISABLE HYSTERESIS
		BSF			CM1CON0,	C1SP	; 1 = FASTER
		BCF			CM1CON0,	C1POL	; 0 = NOT INVERTED, 1 = Comparator
		BSF			CM1CON0,	C1OE	; 1 = COMPARATOR OUTPUT ENABLED
		BSF			CM1CON0,	C1ON	; 1 = COMPARATOR ON
	RETURN	

;	FILENAME: COMPARATOR_LIB.INC
;	DESC: BASIC SETUP ROUTINE
;*****************************************************************
;*****************************************************************
; FUNCTION: COMP1_INIT
;*****************************************************************
COMP2_ENABLE
	BANKSEL		TRISA
	BCF			TRISA,		RA5
	BANKSEL		ANSELA
	MOVLW		0X0F
	IORWF		ANSELA,F			; INSURES THE COMPARATOR INPUTS ARE SET TO ANALOG

	BANKSEL		CM2CON1
	BSF			CM2CON1,	C2NCH0	;\
	BCF			CM2CON1,	C2NCH1	;/  SELECTS PIN 2 OF PIC FOR COMP1'S NEG INPUT
	BCF			CM2CON1,	C2PCH0	;\
	BCF			CM2CON1,	C2PCH1	;/  SELECTS PIN 5 OF PIC FOR COMP1'S POS INPUT
	BSF			CM2CON1,	C2INTN	; INTERRUPT WHEN COMP1 OUT GOES NEGATIVE.
	BSF			CM2CON1,	C2INTP	; OR POSITIVE

	BANKSEL		CM2CON0
	BCF			CM2CON0,	C2SYNC	; 0 = ASINC MODE
	BCF			CM2CON0,	C2HYS	; DISABLE HYSTERESIS
	BSF			CM2CON0,	C2SP	; 1 = FASTER
	BCF			CM2CON0,	C2POL	; 0 = NOT INVERTED, 1 = Comparator
	BSF			CM2CON0,	C2OE	; 1 = COMPARATOR OUTPUT ENABLED
	BSF			CM2CON0,	C2ON	; 1 = COMPARATOR ON

 RETURN